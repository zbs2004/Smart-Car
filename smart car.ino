#include <U8glib.h>
#include <Servo.h>
#include <Wire.h>
#include <IRremote.h>
const unsigned char PROGMEM ri[] = {
0x00,0x00,0x00,0x00,0x00,0x00,0x00,0x00,0x00,0x00,0x00,0x00,0x00,0x00,0x00,0x00,
0x00,0x00,0x00,0x00,0x00,0x00,0x00,0x00,0x00,0x00,0x00,0x00,0x00,0x00,0x00,0x00,
0x00,0x00,0x00,0x00,0x00,0x00,0x00,0x00,0x00,0x00,0x00,0x00,0x00,0x00,0x00,0x00,
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0x00,0x00,0x00,0x00,0x00,0x00,0x00,0x00,0x00,0x00,0x00,0x00,0x00,0x00,0x00,0x00
};
//-------字体设置，大、中、小
#define setFont_L u8g.setFont(u8g_font_7x13)
//红外
int IR_RECEIVE_PIN = 10;
const long Add=-367657216; //加档
const long Div=-133693696;//减档
constexpr long Gear[6]={-384368896,-217252096,-417792256,-1587609856,-150405376,-484638976};//档位
const long Left =-1153106176;//左转
const long Right =-1086259456;//右转
const long Back =-434503936;//后退
const long Straight=-1136394496;//直行
long Order=-1;
//OLED
#define INTERVAL_LCD             20             //定义OLED刷新时间间隔  
unsigned long lcd_time = millis();                 //OLED刷新时间计时器
U8GLIB_SSD1306_128X64 u8g(U8G_I2C_OPT_NONE);     //设置OLED型号  
//超声波
#define TrigPin  2                  //定义超声波传感器引脚
#define EchoPin  3
float distance;                   //定义距离变量
float dis_temp[5];                //距离缓存池用于避障处理
int tail=0;
//舵机
int pos = 0;
Servo myservo;
int c =0;//障碍处理计数器
//PWM电机
int M_Pin = 5;//前进白负黑正
int B_Pin=6;//后退白正黑负
int c_gear=0;//当前档位
int t_gear=0;//调整档位
int b_gear=0;//后退前档位
int tim=0;//时间
int t_enable=1;//计时器使能
int h_enable=1;//手动操作
void setup()

{
  //红外
  Serial.begin(9600);//设置波特率
//  Serial.println("Enabling IRin");
  IrReceiver.begin(IR_RECEIVE_PIN,ENABLE_LED_FEEDBACK);//打开红外
//  Serial.println("Enabled IRin");
  //PWM电机
  pinMode(M_Pin,OUTPUT);          //设置电机PWM
  pinMode(B_Pin,OUTPUT);
  //超声波
  pinMode(TrigPin, OUTPUT);       //设置超声波传感器引脚模式
  pinMode(EchoPin, INPUT);         
  //显示初始化
  u8g.begin();
  //舵机转动  
  myservo.attach(9, 500, 2500);          //修正脉冲宽度
  //显示初始图片
  u8g.firstPage();
  do {
   setFont_L;
   u8g.drawBitmapP(0, 0, 16, 64, ri);
   }while (u8g.nextPage());
  delay(1000);
 }
void loop() {
  IRremote();                      //红外   
  order();                        //处理遥控器命令
  get_dis();                      //获取距离函数
  oled_display();                  //oled显示函数
  stop();                         //避障
  move();                        //默认前进路线
}
void count(){//计时器
  if(t_enable)
  {
  delay(100);
  tim++;
  }
}
void move(){//默认前进函数
  if(h_enable){//手动操作则停止默认前进
  if(tim<=80)gear(3);
  else{t_enable=0;gear(0);}
  }
}
void stop()//避障
{
  int d=0;//距离判断计数器
  int enable=0;//避障使能
  for(int i=0;i<5;i++){//缓存池内所有数据均满足小于6cm才打开避障，提高精度
    if(dis_temp[i]<=6){
      d++;
    }
  }
  if(d>=5) enable=1;
  if(enable){
    b_gear=c_gear;//记录避障前档位
    gear(0);//先停车
    gear(-1);//后倒车
    delay(2000);
    gear(b_gear);//恢复档位
    if(c%2){servo(1);c++;}//定型调整方向
    else{ servo(-1);c++;}
    enable=0;//关闭避障使能
  }
}
void order()//处理红外命令，档位设置均视为手动操作并关闭默认前进
{
  switch(Order)
  {
     case Add://加档
     if(c_gear<=5)
     {gear(++c_gear);Order=-1;h_enable=0;break;}
     else{Order=-1;h_enable=0; break;}
     case Div://减档
     if(c_gear>=-1)
     {gear(--c_gear);Order=-1;h_enable=0;break;}
     else {Order=-1;h_enable=0;break;}
     case Gear[0]://空挡
     gear(0);
     Order=-1;
     h_enable=0;//手动操作使能打开
     break;
     case Gear[1]://1档
     gear(1);
     Order=-1;
     h_enable=0;
     break;
     case Gear[2]://2档
     gear(2);
     Order=-1;
     h_enable=0;
     break;
     case Gear[3]://3档
     gear(3);
     Order=-1;
     h_enable=0;
     break;
     case Gear[4]://4档
     gear(4);
     Order=-1;
     h_enable=0;
     break;
     case Gear[5]://5档
     gear(5);
     Order=-1;
     h_enable=0;
     break;
     case Left://左转
     servo(-1);
     Order=-1;
     break;
     case Right://右转
     servo(1);
     Order=-1;
     break;
     case Back://倒车
     gear(-1);
     Order=-1;
     h_enable=0;
     break;
     case Straight://直行
     servo(0);
     Order=-1;
     break;
  }
}
void IRremote()//红外
{
  if (IrReceiver.decode()) { //打开红外
    Order=IrReceiver.decodedIRData.decodedRawData;//储存命令
//    Serial.println(Order,DEC);
    IrReceiver.resume();      //关闭红外
  }
}
void get_dis()                    //获取距离子函数
{
  digitalWrite(TrigPin, LOW);//定时测距
  delayMicroseconds(2);
  digitalWrite(TrigPin, HIGH);
  delayMicroseconds(10);
  digitalWrite(TrigPin, LOW);
  distance = pulseIn(EchoPin, HIGH) / 58.0;//计算距离
  tail=tail%5;//头指针格式化
  dis_temp[tail]=distance;//储存距离
  tail++;
  //Serial.print(distance);
  //Serial.println("cm");
}
void oled_display()                //lcd显示子函数
{
  int dis = int(distance);
  u8g.firstPage();
  do {
  setFont_L;
  u8g.setPrintPos(0,10);
  u8g.print("Distance:");
  u8g.print(dis);
  u8g.print("cm");
  }while (u8g.nextPage());
}
void servo(int t)//舵机档位
{
  switch(t)
  {
    case 0://归原位
    t_gear=c_gear;//记录档位
    gear(0);//先停车
    myservo.write(0);//后转向
    delay(100);
    gear(t_gear);//回归档位
    break;
    case -1://左45
    t_gear=c_gear;//记录档位
    gear(0);//先停车
    myservo.write(135);//后转向
    delay(100);
    gear(t_gear);//回归档位
    break;
    case 1://右45
    t_gear=c_gear;//记录档位
    gear(0);//先停车
    myservo.write(45);//后转向
    delay(100);
    gear(t_gear);//回归档位
    break;
  }
}
void gear(int t)//档位
{
  switch(t)
  {
    case -1://倒挡
    analogWrite(B_Pin,200);
    analogWrite(M_Pin,0);
    c_gear=t;
    break;
    case 0://空挡
    analogWrite(M_Pin,0);
    analogWrite(B_Pin,0);
    c_gear=t;
    break;
    case 1://1-5前进档
    analogWrite(M_Pin,151);
    analogWrite(B_Pin,0);
    c_gear=t;
    break;
    case 2:
    analogWrite(M_Pin,176);
    analogWrite(B_Pin,0);
    c_gear=t;
    break;
    case 3:
    analogWrite(M_Pin,201);
    analogWrite(B_Pin,0);
    c_gear=t;
    break;
    case 4:
    analogWrite(M_Pin,226);
    analogWrite(B_Pin,0);
    c_gear=t;
    break;
    case 5:
    analogWrite(M_Pin,255);
    analogWrite(B_Pin,0);
    c_gear=t;
    break;
  }
}
